#include <Adafruit_GFX.h>   // Core graphics library
#include <RGBmatrixPanel.h> // Hardware-specific library
#include <SoftWire.h>
#include <AsyncDelay.h>

#define CLK 8  // MUST be on PORTB! (Use pin 11 on Mega)
#define OE  9
#define LAT 10
#define A   A0
#define B   A1
#define C   A2
#define D   A3

RGBmatrixPanel matrix(A, B, C, D, CLK, LAT, OE, false);
SoftWire sw(A4, A5);

#define DIGIT_HEIGHT 5
#define DIGIT_WIDTH 3

// TODO: These can be packed MUCH better:
static const uint8_t DIGIT_PIXELS[DIGIT_HEIGHT * DIGIT_WIDTH * 10] PROGMEM = {
    1,1,1, 0,1,0, 1,1,1, 1,1,1, 1,0,1, 1,1,1, 1,1,1, 1,1,1, 1,1,1, 1,1,1,
    1,0,1, 0,1,0, 0,0,1, 0,0,1, 1,0,1, 1,0,0, 1,0,0, 0,0,1, 1,0,1, 1,0,1,
    1,0,1, 0,1,0, 1,1,1, 0,1,1, 1,1,1, 1,1,1, 1,1,1, 0,0,1, 1,1,1, 1,1,1,
    1,0,1, 0,1,0, 1,0,0, 0,0,1, 0,0,1, 0,0,1, 1,0,1, 0,0,1, 1,0,1, 0,0,1,
    1,1,1, 0,1,0, 1,1,1, 1,1,1, 0,0,1, 1,1,1, 1,1,1, 0,0,1, 1,1,1, 0,0,1
};

static const uint32_t LINK_PALETTE[] PROGMEM = {0x008800, 0xba3002, 0xd38437, 0x000000, 0x000000, 0x000000, 0x000000, 0x000000, 0x000000, 0x000000, 0x000000, 0x000000, 0x000000, 0x000000, 0x000000};
static const int8_t LINK_FRAME_1[] PROGMEM = {0x0,0x0,0x11,0x11,0x11,0x11,0x0,0x0,0x0,0x30,0x12,0x22,0x22,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0x0,0x0};
static const int8_t LINK_FRAME_2[] PROGMEM = {0x0,0x0,0x1,0x11,0x11,0x10,0x0,0x0,0x0,0x0,0x11,0x11,0x11,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0x0,0x0};
static const uint32_t PLANT_PALETTE[] PROGMEM = {0x1e8400, 0xd78d22, 0xffffff, 0x0000ff, 0xffff00, 0x00ffff, 0xff00ff, 0xffffff, 0x000000, 0x000000, 0x000000, 0x000000, 0x000000, 0x000000, 0x000000};
static const int8_t PLANT_FRAME_1[] PROGMEM = {0x00,0x00,0x00,0x00,0x00,0x00,0x00,0x00,0x00,0x00,0x00,0x00,0x00,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0x00,0x00};
static const int8_t PLANT_FRAME_2[] PROGMEM = {0x00,0x00,0x00,0x00,0x00,0x00,0x00,0x00,0x00,0x00,0x00,0x00,0x00,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0x00,0x00};

// We're making these globals to save stack space.
int row;                        ///< Row count, when looping.
int col;                        ///< Column count, when looping.
unsigned char paletteIndex;     ///< Index into the color palette.
unsigned long pixelPosition;    ///< Index into the pixel array.
unsigned char red;              ///< Red color value, pulled from the palette.
unsigned char green;            ///< Green color value, pulled from the palette.
unsigned char blue;             ///< Blue color value, pulled from the palette.
uint16_t mixedColor;
uint8_t hours = 0;
uint8_t minutes = 0;
uint8_t seconds = 0;

void setup() 
{
    matrix.begin();
    matrix.fillScreen(matrix.Color333(0, 0, 0));
    sw.begin();
    sw.setTimeout_ms(500);
    sw.setDelay_us(100);
}

bool getTime()
{
    uint8_t b1 = 0, b2 = 0, b3 = 0;
    sw.startWriteWait(0x68);
    sw.write(0);
    sw.stop();
    sw.startReadWait(0x68);
    sw.readThenAck(b1);
    sw.readThenAck(b2);
    sw.readThenNack(b3);
    sw.stop();
    seconds = (b1 >> 4) * 10 + (b1 & 0x0F);
    minutes = (b2 >> 4) * 10 + (b2 & 0x0F);
    hours = ((b3 >> 4) & 0x01) * 10 + (b3 & 0x0F);
    return true;
}

bool getPixelForTime(uint8_t x, uint8_t y)
{
    int8_t digit = -1; // 0..9 indicates the actual digit. -1 indicates space, -2 indicates colon
    if (y >= 5)
        return false;
    if (x <= 2)
    {
        digit = hours / 10;
    }
    else if (x >= 4 && x <= 6)
    {
        digit = hours % 10;
        x -= 4;
    }
    else if (8 == x)
    {
        digit = -2;
    }
    else if (x >= 10 && x <= 12)
    {
        digit = minutes / 10;
        x -= 10;
    }
    else if (x >= 14 && x <= 16)
    {
        digit = minutes % 10;
        x -= 14;
    }
    else if (18 == x)
    {
        digit = -2;
    }
    else if (x >= 20 && x <= 22)
    {
        digit = seconds / 10;
        x -= 20;
    }
    else if (x >= 24 && x <= 26)
    {
        digit = seconds % 10;
        x -= 24;
    }
    if (-1 == digit)
        return false;
    if (-2 == digit)
        return y == 1 || y == 3;
    return pgm_read_byte(DIGIT_PIXELS + (y * DIGIT_WIDTH * 10) + (digit * DIGIT_WIDTH + x));
}

void draw16x32ByNibble(const unsigned char *pixels, const void *palette)
{
    pixelPosition = 0;
    for (row = 0; row < 5; row++)
    {
        for (col = 0; col < 8; col++)
        {
            if (getPixelForTime(col, row))
                mixedColor = matrix.Color444(4, 0, 0);
            else
                mixedColor = matrix.Color444(0, 0, 0);
            matrix.drawPixel(col, row, mixedColor);
            if (getPixelForTime(24 + col, row))
                mixedColor = matrix.Color444(4, 0, 0);
            else
                mixedColor = matrix.Color444(0, 0, 0);
            matrix.drawPixel(24 + col, row, mixedColor);
        }
    }
    for (row = 0; row < 32; row++)
    {
        for (col = 0; col < 16; col++)
        {
            red = green = blue = 0; // Assume transparent is black.
            paletteIndex = pgm_read_byte(pixels + pixelPosition); // Find the byte containing the two pixels.
            if (0 == col % 2)
                paletteIndex = paletteIndex >> 4;
            else
                paletteIndex = paletteIndex & 0x0F;
            if (paletteIndex > 0 && paletteIndex < 16)
            {
                red = pgm_read_byte(palette + 4 * (paletteIndex - 1) + 2);
                green = pgm_read_byte(palette + 4 * (paletteIndex - 1) + 1);
                blue = pgm_read_byte(palette + 4 * (paletteIndex - 1) + 0);
            }
            mixedColor = matrix.Color888(red, green, blue);
            if (0 == mixedColor && getPixelForTime(col + 8, row))
                mixedColor = matrix.Color444(4, 0, 0);
            matrix.drawPixel(col + 8, row, mixedColor); 
            if (col % 2 == 1)
                pixelPosition++;
        }
    }
}

void loop() 
{
    static const uint8_t TEST_CASE = 3;
    switch(TEST_CASE)
    {
        case 1: draw16x32ByNibble(PLANT_FRAME_1, PLANT_PALETTE); break;
        case 2: draw16x32ByNibble(PLANT_FRAME_2, PLANT_PALETTE); break;
        case 3:
            getTime();
            draw16x32ByNibble(PLANT_FRAME_1, PLANT_PALETTE); 
            delay(500);
            draw16x32ByNibble(PLANT_FRAME_2, PLANT_PALETTE);
            break;
    }
    delay(500);
}


