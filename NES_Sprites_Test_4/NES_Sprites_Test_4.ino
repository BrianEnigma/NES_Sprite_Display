#include <Adafruit_GFX.h>   // Core graphics library
#include <RGBmatrixPanel.h> // Hardware-specific library

#define CLK 8  // MUST be on PORTB! (Use pin 11 on Mega)
#define OE  9
#define LAT 10
#define A   A0
#define B   A1
#define C   A2
#define D   A3

RGBmatrixPanel matrix(A, B, C, D, CLK, LAT, OE, false);

static const uint32_t LINK_PALETTE[] PROGMEM = {0x008800, 0xba3002, 0xd38437, 0x000000, 0x000000, 0x000000, 0x000000, 0x000000, 0x000000, 0x000000, 0x000000, 0x000000, 0x000000, 0x000000, 0x000000};
static const int8_t LINK_FRAME_1[] PROGMEM = {0x0,0x0,0x11,0x11,0x11,0x11,0x0,0x0,0x0,0x30,0x12,0x22,0x22,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0x0,0x0};
static const int8_t LINK_FRAME_2[] PROGMEM = {0x0,0x0,0x1,0x11,0x11,0x10,0x0,0x0,0x0,0x0,0x11,0x11,0x11,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0x0,0x0};
static const uint32_t PLANT_PALETTE[] PROGMEM = {0x1e8400, 0xd78d22, 0xffffff, 0x0000ff, 0xffff00, 0x00ffff, 0xff00ff, 0xffffff, 0x000000, 0x000000, 0x000000, 0x000000, 0x000000, 0x000000, 0x000000};
static const int8_t PLANT_FRAME_1[] PROGMEM = {0x00,0x00,0x00,0x00,0x00,0x00,0x00,0x00,0x00,0x00,0x00,0x00,0x00,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0x00,0x00};
static const int8_t PLANT_FRAME_2[] PROGMEM = {0x00,0x00,0x00,0x00,0x00,0x00,0x00,0x00,0x00,0x00,0x00,0x00,0x00,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0x00,0x00};


// We're making these globals to save stack space.
int row;                        ///< Row count, when looping.
int col;                        ///< Column count, when looping.
unsigned char red;              ///< Red color value, pulled from the palette.
unsigned char green;            ///< Green color value, pulled from the palette.
unsigned char blue;             ///< Blue color value, pulled from the palette.
unsigned char paletteIndex;     ///< Index into the color palette.
unsigned long pixelPosition;    ///< Index into the pixel array.
uint16_t mixedColor;

void setup() 
{
    matrix.begin();
    matrix.fillScreen(matrix.Color333(0, 0, 0));
}

void draw16x32ByNibble(const unsigned char *pixels, const void *palette)
{
    pixelPosition = 0;
    for (row = 0; row < 32; row++)
    {
        for (col = 0; col < 16; col++)
        {
            red = green = blue = 0; // Assume transparent is black.
            paletteIndex = pgm_read_byte(pixels + pixelPosition); // Find the byte containing the two pixels.
            if (0 == col % 2)
                paletteIndex = paletteIndex >> 4;
            else
                paletteIndex = paletteIndex & 0x0F;
            if (paletteIndex > 0 && paletteIndex < 16)
            {
                red = pgm_read_byte(palette + 4 * (paletteIndex - 1) + 2);
                green = pgm_read_byte(palette + 4 * (paletteIndex - 1) + 1);
                blue = pgm_read_byte(palette + 4 * (paletteIndex - 1) + 0);
            }
            mixedColor = matrix.Color888(red, green, blue);
            matrix.drawPixel(col + 8, row, mixedColor); 
            if (col % 2 == 1)
                pixelPosition++;
        }
    }
}

void draw16x16ByNibble(const unsigned char *pixels, const void *palette)
{
    pixelPosition = 0;
    for (row = 0; row < 16; row++)
    {
        for (col = 0; col < 16; col++)
        {
            red = green = blue = 0; // Assume transparent is black.
            paletteIndex = pgm_read_byte(pixels + pixelPosition); // Find the byte containing the two pixels.
            if (0 == col % 2)
                paletteIndex = paletteIndex >> 4;
            else
                paletteIndex = paletteIndex & 0x0F;
            if (paletteIndex > 0 && paletteIndex < 16)
            {
                red = pgm_read_byte(palette + 4 * (paletteIndex - 1) + 2);
                green = pgm_read_byte(palette + 4 * (paletteIndex - 1) + 1);
                blue = pgm_read_byte(palette + 4 * (paletteIndex - 1) + 0);
            }
            mixedColor = matrix.Color888(red, green, blue);
            matrix.drawPixel(col * 2,     row * 2,     mixedColor); 
            matrix.drawPixel(col * 2 + 1, row * 2,     mixedColor); 
            matrix.drawPixel(col * 2,     row * 2 + 1, mixedColor); 
            matrix.drawPixel(col * 2 + 1, row * 2 + 1, mixedColor); 
            if (col % 2 == 1)
                pixelPosition++;
        }
    }
}

void loop() 
{
    static const uint8_t TEST_CASE = 3;
    switch(TEST_CASE)
    {
        case 1: draw16x32ByNibble(PLANT_FRAME_1, PLANT_PALETTE); break;
        case 2: draw16x32ByNibble(PLANT_FRAME_2, PLANT_PALETTE); break;
        case 3: 
            draw16x32ByNibble(PLANT_FRAME_1, PLANT_PALETTE); 
            delay(500);
            draw16x32ByNibble(PLANT_FRAME_2, PLANT_PALETTE);
            break;
    }
    delay(500);
}
