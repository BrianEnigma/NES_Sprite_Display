#include <Adafruit_GFX.h>   // Core graphics library
#include <RGBmatrixPanel.h> // Hardware-specific library

#define CLK 8  // MUST be on PORTB! (Use pin 11 on Mega)
#define OE  9
#define LAT 10
#define A   A0
#define B   A1
#define C   A2
#define D   A3

RGBmatrixPanel matrix(A, B, C, D, CLK, LAT, OE, false);

//static const uint32_t LINK_PALETTE[] = {0xc5f552, 0xd6642d, 0xf3a457, 0x000000, 0x000000, 0x000000, 0x000000, 0x000000, 0x000000, 0x000000, 0x000000, 0x000000, 0x000000, 0x000000, 0x000000};
static const uint32_t LINK_PALETTE[] = {0x008800, 0xba3002, 0xd38437, 0x000000, 0x000000, 0x000000, 0x000000, 0x000000, 0x000000, 0x000000, 0x000000, 0x000000, 0x000000, 0x000000, 0x000000};
static const int8_t LINK_FRAME_1[] PROGMEM = {0x0,0x0,0x11,0x11,0x11,0x11,0x0,0x0,0x0,0x30,0x12,0x22,0x22,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0x0,0x0};
static const int8_t LINK_FRAME_2[] PROGMEM = {0x0,0x0,0x1,0x11,0x11,0x10,0x0,0x0,0x0,0x0,0x11,0x11,0x11,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0x0,0x0};

// We're making these globals to save stack space.
int row;                        ///< Row count, when looping.
int col;                        ///< Column count, when looping.
unsigned long colorValue;       ///< The actual RRGGBB hex color value.
unsigned char paletteIndex;     ///< Index into the color palette.
unsigned long pixelPosition;    ///< Index into the pixel array.

void setup() 
{
    matrix.begin();
    matrix.fillScreen(matrix.Color333(0, 0, 0));
}

void draw16x16ByNibble(const unsigned char *pixels, const unsigned long *palette)
{
    pixelPosition = 0;
    for (row = 0; row < 16; row++)
    {
        for (col = 0; col < 16; col++)
        {
            colorValue = 0; // Assume transparent is black.
            paletteIndex = pgm_read_byte(pixels + pixelPosition); // Find the byte containing the two pixels.
            if (0 == col % 2)
                paletteIndex = paletteIndex >> 4;
            else
                paletteIndex = paletteIndex & 0x0F;
            if (paletteIndex > 0 && paletteIndex < 16)
                colorValue = *(palette + paletteIndex - 1);
            matrix.drawPixel(col, row, matrix.Color888((colorValue >> 16) & 0xFF, (colorValue >> 8) & 0xFF, colorValue & 0xFF)); 
            if (col % 2 == 1)
                pixelPosition++;
        }
    }
}


void loop() 
{
    static const uint8_t TEST_CASE = 3;
    switch(TEST_CASE)
    {
        case 1: draw16x16ByNibble(LINK_FRAME_1, LINK_PALETTE); break;
        case 2: draw16x16ByNibble(LINK_FRAME_2, LINK_PALETTE); break;
        case 3: 
            draw16x16ByNibble(LINK_FRAME_1, LINK_PALETTE); 
            delay(500);
            draw16x16ByNibble(LINK_FRAME_2, LINK_PALETTE);
            break;
    }
    delay(500);
}
